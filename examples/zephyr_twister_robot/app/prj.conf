## CMakeLists.txt
```
cmake_minimum_required(VERSION 3.20.0)
find_package(Zephyr REQUIRED HINTS $ENV{ZEPHYR_BASE})
project(twister_robot)
target_sources(app PRIVATE src/main.c)
```

## sample.yaml
```
# Zephyr's twister runs shell.robot through renode-test (harness: robot) on Renode boards.
# ./robot-box twister -p riscv32_virtual -T <this folder>   (renode-test is the robot-box shim)
sample:
  name: twister robot harness
tests:
  examples.robot.shell:
    harness: robot
    harness_config:
      robot_testsuite: shell.robot
    platform_allow:
      - riscv32_virtual
    integration_platforms:
      - riscv32_virtual
    tags: [robot, renode, shell]
```

## prj.conf
```kconfig
CONFIG_SHELL=y
CONFIG_KERNEL_SHELL=y
CONFIG_DEVICE_SHELL=y
```

## src/main.c
```c
#include <zephyr/kernel.h>
#include <zephyr/shell/shell.h>

static int cmd_hello(const struct shell *sh, size_t argc, char **argv)
{
	shell_print(sh, "hello %s", argc > 1 ? argv[1] : "world");
	return 0;
}
static int cmd_up(const struct shell *sh, size_t argc, char **argv)
{
	shell_print(sh, "uptime %lld ms", k_uptime_get());
	return 0;
}
SHELL_STATIC_SUBCMD_SET_CREATE(demo_cmds,
	SHELL_CMD_ARG(hello, NULL, "hello [name]", cmd_hello, 1, 1),
	SHELL_CMD(uptime, NULL, "print uptime", cmd_up),
	SHELL_SUBCMD_SET_END);
SHELL_CMD_REGISTER(demo, &demo_cmds, "demo commands", NULL);

int main(void) { return 0; }
```
